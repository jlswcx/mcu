#include "config.h"

#include "macro.h"
#include "port.h"

#define     BEEP_DIR    TRISA5
#define     BEEP_IO     LATA5

unsigned int const note_l[7] = {262, 294, 330, 349, 392, 440, 494};
unsigned int const note_m[7] = {523, 587, 659, 698, 784, 880, 988};
unsigned int const note_h[7] = {1046, 1175, 1318, 1397, 1568, 1760, 1967};


unsigned char const qcxlsc[]={\
0,2,8, 5,2,8, 1,3,8, 2,3,8, \
3,3,4, 5,2,4, 4,3,8, 3,3,8, 2,3,8, 1,3,8, \
7,2,8, 7,2,4, 5,3,8, 5,3,4,\
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0,0,0};


unsigned char const bgddzwc[]={\
0,2,4, 0,2,8, 3,3,8, 3,3,8, 2,3,8, 2,3,8, 1,3,8, \
1,3,4, 6,2,8, 6,2,8, 2,3,8, 3,3,8, 5,3,8, 5,3,16, 3,3,16, \
3,3,4, 3,3,8, 3,3,8, 3,3,8, 2,3,8, 2,3,8, 1,3,8, \
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0,0,0 };
    
unsigned char tmr1_con, tmr1_h, tmr1_l;

void Beep_Init() {
    BEEP_DIR = 0;
    BEEP_IO = 0;
}

void TMR1_Init() {

    TMR1H = 0;                     // 定时器
    TMR1L = 0; 
    
    TMR1ON = 1;
    TMR1IE = 1 ;
    TMR1IF = 0 ;
    PEIE = 1;
    GIE = 1;
}

void __interrupt() isr(void) {
    
//    unsigned int static i = 0;
//    unsigned int static j = 0;
     if(TMR1IF == 1) { 

//        unsigned int T = 0;
//        unsigned int M = 0;
//        
//        
//        if(j > 70) {
//            i++; j = 0;
//            if(i > 6) i = 0;
//        }else {
//            j++;
//        }
//        
//        
//        T = T + _XTAL_FREQ_1M / note_l[i] / 2;
//        M = 0xFFFF - T * 4 / (4 * 1);   // 定时初始值计算公式 T*F/N  
         
        BEEP_IO = !BEEP_IO;

        TMR1H = tmr1_h;                     // 定时器
        TMR1L = tmr1_l; 
        

        TMR1IF = 0;
        

     }
}

void delay(unsigned char t) 
{

    if(t == 1) {
        __delay_ms(100);
    }else if(t == 2){
        __delay_ms(200);
    }else if(t == 3){
        __delay_ms(300);
    }else if(t == 4){
        __delay_ms(400);
    }else if(t == 5){
        __delay_ms(500);
    }else if(t == 6){
        __delay_ms(600);
    }
    
    

}


void main() {

    OSCCON = OSCCON_125K;       // 初始化晶振
    
    unsigned int i = 0;
    
    PORT_Init();
    
    Beep_Init();
       
    TMR1_Init();
    
    while(1){
        unsigned int audio, tone, duration, tune;       // 音阶，音调，音长，曲调
        unsigned int T, M;
        
        audio = tone = duration = tune = T = M = 0;
        unsigned char const *p = bgddzwc; 
        
        // 空音为 0
        audio = p[i];
        tone = p[i + 1];
        duration = 16 / p[i + 2]; 
        
        if(audio == 0 && tone == 0 && duration == 0) {
            i = 0;
        }else {
            i = i + 3;
            
            if(audio == 0) {
                GIE = 0;
                delay(duration);
                GIE = 1;
            }else {
                audio = audio - 1;

                if(tone == 1){
                    audio = note_l[audio];
                }else if(tone == 2) {
                    audio = note_m[audio];
                }else if(tone == 3) {
                    audio = note_h[audio];
                }  

                T = T + _XTAL_FREQ_1M / audio / 2;
                M = 0xFFFF - T * 4 / (4 * 1);   // 定时初始值计算公式 T*F/N     

                tmr1_h = M / 256;
                tmr1_l = M % 256;  
                
                delay(duration); 
            }
        }

    };
}